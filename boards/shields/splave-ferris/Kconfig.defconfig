## boards/shields/splave-ferris/Kconfig.defconfig
```kconfig
# Copyright (c) 2020 The ZMK Contributors
# SPDX-License-Identifier: MIT

if SHIELD_SPLAVE-FERRIS_LEFT

config ZMK_KEYBOARD_NAME
    default "Splave-Ferris"

config ZMK_SPLIT_ROLE_CENTRAL
    default y

endif

if SHIELD_SPLAVE-FERRIS_LEFT || SHIELD_SPLAVE-FERRIS_RIGHT

config ZMK_SPLIT
    default y

endif
```

## boards/shields/splave-ferris/Kconfig.shield
```kconfig
# Copyright (c) 2020 The ZMK Contributors
# SPDX-License-Identifier: MIT

config SHIELD_SPLAVE-FERRIS_LEFT
    def_bool $(shields_list_contains,splave-ferris_left)

config SHIELD_SPLAVE-FERRIS_RIGHT
    def_bool $(shields_list_contains,splave-ferris_right)
```

## config/Kconfig.defconfig
```kconfig
# Copyright (c) 2020 The ZMK Contributors
# SPDX-License-Identifier: MIT

if SHIELD_SPLAVE-FERRIS_LEFT

config ZMK_SPLAVE-FERRIS
    default "Splave-Ferris"

config ZMK_SPLIT_ROLE_CENTRAL
    default y

endif

if SHIELD_SPLAVE-FERRIS_LEFT || SHIELD_SPLAVE-FERRIS_RIGHT

config ZMK_SPLIT
    default y

endif
```

## config/west.yml
```yaml
manifest:
  remotes:
    - name: zmkfirmware
      url-base: https://github.com/zmkfirmware
    - name: jusdisgi
      url-base: https://github.com/jusdisgi
    # Additional modules containing boards/shields/custom code can be listed here as well
    # See https://docs.zephyrproject.org/3.2.0/develop/west/manifest.html#projects
  projects:
    - name: zmk
      remote: zmkfirmware
      revision: main
      import: app/west.yml
    - name: zmk-keyboards-splaveferris
      remote: jusdisgi
      revision: main
  self:
    path: config
```
